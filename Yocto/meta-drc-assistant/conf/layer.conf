## Yocto/meta-drc-assistant/conf/layer.conf
```bitbake
BBPATH .= ":${LAYERDIR}"
BBFILES += "${LAYERDIR}/recipes-*/*/*.bb"

BBFILE_COLLECTIONS += "drc-assistant"
BBFILE_PATTERN_drc-assistant = "^${LAYERDIR}/"
BBFILE_PRIORITY_drc-assistant = "10"

LAYERSERIES_COMPAT_drc-assistant = "kirkstone"
```
